VERSION ""

NS_ :

BS_:

BU_: XXX

BO_ 883 NEW_MSG_1: 8 XXX
 SG_ NEW_SIGNAL_1 : 24|3@1+ (1,0) [0|7] "" XXX

BO_ 281 NEW_MSG_2: 8 XXX
 SG_ NEW_SIGNAL_1 : 44|21@0+ (1,0) [0|2097151] "" XXX
