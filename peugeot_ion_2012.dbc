VERSION ""

NS_ :

BS_:

BU_: XXX

BO_ 883 NEW_MSG_1: 8 XXX
 SG_ NEW_SIGNAL_1 : 24|3@1+ (1,0) [0|7] "" XXX

BO_ 281 NEW_MSG_2: 8 XXX
 SG_ NEW_SIGNAL_1 : 44|21@0+ (1,0) [0|2097151] "" XXX

BO_ 1761 battery_cell_0: 8 XXX

BO_ 1762 battery_cell_1: 8 XXX

BO_ 1763 battery_cell_2: 8 XXX

BO_ 1764 battery_cell_3: 8 XXX

BO_ 520 brake_pedal: 8 XXX
 SG_ brake_pedal_position : 23|16@0+ (1,0) [0|65535] "" XXX
